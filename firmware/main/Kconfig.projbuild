## firmware/main/Kconfig.projbuild
```kconfig
menu "s3-kolonka"

    config KOLONKA_BRAIN_HOST
        string "Voice gateway host"
        default "192.168.1.10"
        help
            IPv4 or hostname of the WebSocket gateway.
            Keep production addresses in local sdkconfig, not in git.

    config KOLONKA_BRAIN_PORT
        int "Voice gateway port"
        default 8765
        range 1 65535

    config KOLONKA_FULL_DUPLEX_WS
        bool
        default y
        select ESP_WS_CLIENT_SEPARATE_TX_LOCK

    config LV_MEM_SIZE_KILOBYTES
        int "Size of the memory used by lv_mem_alloc in kilobytes (>= 2kB)"
        default 48

    config BT_ENABLED
        bool "Select this option to enable Bluetooth"
        default y

    config BT_BLE_50_FEATURES_SUPPORTED
        bool "Enabling this option activates BLE 5.0 features"
        default y

    config BT_BLE_42_FEATURES_SUPPORTED
        bool "This enables BLE 4.2 features."
        default y

endmenu
```

## firmware/sdkconfig.defaults
```kconfig
CONFIG_KOLONKA_BRAIN_HOST="192.168.1.10"
CONFIG_KOLONKA_BRAIN_PORT=8765

CONFIG_SPIRAM=y
CONFIG_SPIRAM_MODE_OCT=y
CONFIG_SPIRAM_SPEED_80M=y
CONFIG_SPIRAM_USE_CAPS_ALLOC=y
CONFIG_SPIRAM_TRY_ALLOCATE_WIFI_LWIP=y

CONFIG_ESPTOOLPY_FLASHSIZE_16MB=y
CONFIG_ESPTOOLPY_FLASHMODE_QIO=y
CONFIG_PARTITION_TABLE_CUSTOM=y
CONFIG_ESP_DEFAULT_CPU_FREQ_MHZ_240=y
CONFIG_ESP_CONSOLE_USB_SERIAL_JTAG=y

CONFIG_ESP32S3_DATA_CACHE_LINE_64B=y
CONFIG_ESP32S3_DATA_CACHE_LINE_SIZE=64
CONFIG_ESP32S3_DATA_CACHE_64KB=y
CONFIG_ESP32S3_DATA_CACHE_SIZE=0x20000

CONFIG_FATFS_LFN_STACK=y
CONFIG_FATFS_MAX_LFN=255
CONFIG_FATFS_API_ENCODING_ANSI_OEM=y

CONFIG_ESP_WIFI_STATIC_RX_BUFFER_NUM=10
CONFIG_ESP_WIFI_RX_BA_WIN=6
CONFIG_LWIP_TCP_OOSEQ_MAX_PBUFS=4

CONFIG_I2S_ISR_IRAM_SAFE=y
CONFIG_I2S_SUPPRESS_DEPRECATE_WARN=y

CONFIG_LV_USE_USER_DATA=y
CONFIG_LV_COLOR_16_SWAP=y
CONFIG_LV_FONT_MONTSERRAT_12=y
CONFIG_LV_FONT_MONTSERRAT_14=y
CONFIG_LV_FONT_MONTSERRAT_16=y
CONFIG_LV_USE_FONT_COMPRESSED=y
CONFIG_LV_USE_DEMO_WIDGETS=y
CONFIG_LV_USE_DEMO_KEYPAD_AND_ENCODER=y
CONFIG_LV_USE_DEMO_BENCHMARK=y
CONFIG_LV_USE_DEMO_STRESS=y
CONFIG_LV_USE_DEMO_MUSIC=y

CONFIG_PARTITION_TABLE_CUSTOM_FILENAME="partitions.csv"
```
